## meta-progra/conf/layer.conf
```bitbake
BBPATH .= ":${LAYERDIR}"

BBFILES += "${LAYERDIR}/recipes-*/*/*.bb \
        ${LAYERDIR}/recipes-*/*/*.bbappend"

BBFILE_COLLECTIONS += "progra"
BBFILE_PATTERN_progra = "^${LAYERDIR}/"
BBFILE_PRIORITY_progra = "6"
LAYERVERSION_progra = "4"
LAYERSERIES_COMPAT_progra = "warrior"
```

## rpi2/conf/bblayers.conf
```bitbake
# POKY_BBLAYERS_CONF_VERSION is increased each time build/conf/bblayers.conf
# changes incompatibly
POKY_BBLAYERS_CONF_VERSION = "2"

BBPATH = "${TOPDIR}"
BBFILES ?= ""

BBLAYERS ?= " \
  /home/edgardo/poky/meta \
  /home/edgardo/poky/meta-poky \
  /home/edgardo/poky/meta-yocto-bsp \
  /home/edgardo/poky/meta-raspberrypi \
  /home/edgardo/poky/meta-openembedded/meta-oe \
  /home/edgardo/poky/meta-openembedded/meta-python \
  /home/edgardo/poky/meta-progra \
  "
```

## rpi2/conf/local.conf
```bitbake
DISTRO ?= "poky"
PACKAGE_CLASSES ?= "package_rpm"
EXTRA_IMAGE_FEATURES ?= "debug-tweaks"
USER_CLASSES ?= "buildstats image-mklibs image-prelink"
PATCHRESOLVE = "noop"
BB_DISKMON_DIRS ??= "\
    STOPTASKS,${TMPDIR},1G,100K \
    STOPTASKS,${DL_DIR},1G,100K \
    STOPTASKS,${SSTATE_DIR},1G,100K \
    STOPTASKS,/tmp,100M,100K \
    ABORT,${TMPDIR},100M,1K \
    ABORT,${DL_DIR},100M,1K \
    ABORT,${SSTATE_DIR},100M,1K \
    ABORT,/tmp,10M,1K"
PACKAGECONFIG_append_pn-qemu-system-native = " sdl"
PACKAGECONFIG_append_pn-nativesdk-qemu = " sdl"
CONF_VERSION = "1"

#Se agrega para poder crear la imagen sato, ademas de meta-oe 
MACHINE ?= "raspberrypi2"
INHERIT += "rm_work"
DL_DIR ?= "/home/edgardo/poky/downloads"
LICENSE_FLAGS_WHITELIST = "commercial"

#Agregamos lo necesario para el correcto funcionamiento de la aplicacion
#Primero se agrega python y los diferentes paquetes necesarios
IMAGE_INSTALL_append = " python3"
IMAGE_INSTALL_append = " python3-numpy"
IMAGE_INSTALL_append = " python3-datetime"

#Se agrega OpenCV y los diferentes paquetes necesarios de openCV
CORE_IMAGE_EXTRA_INSTALL += "opencv"
CORE_IMAGE_EXTRA_INSTALL += "libopencv-core"
CORE_IMAGE_EXTRA_INSTALL += "libopencv-imgproc"
CORE_IMAGE_EXTRA_INSTALL += "libopencv-highgui"
CORE_IMAGE_EXTRA_INSTALL += "libopencv-objdetect"

#Se agrega el paquete para el acceso de los pines de la Raspberry Pi
CORE_IMAGE_EXTRA_INSTALL += "rpio"

#Para captura de video son necesarios los siguientes paquetes
IMAGE_INSTALL_append = " v4l-utils"
IMAGE_INSTALL_append = " gstreamer1.0"
IMAGE_INSTALL_append = " gstreamer1.0-plugins-base"
IMAGE_INSTALL_append = " gstreamer1.0-plugins-good"
IMAGE_INSTALL_append = " gstreamer1.0-plugins-bad"
IMAGE_INSTALL_append = " gstreamer1.0-plugins-ugly"
PACKAGECONFIG_append_pn-gst-plugins-good = "v4l"

#Se agrega el manejador de ventanas
DISTRO_FEATURES_append = " x11"
EXTRA_IMAGE_FEATURES += "x11" 
```
